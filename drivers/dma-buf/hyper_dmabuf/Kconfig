## drivers/dma-buf/hyper_dmabuf/Kconfig
```kconfig
menu "HYPER_DMABUF"

config HYPER_DMABUF
	tristate "Enables hyper dmabuf driver"
	default y
	help
	  This option enables Hyper_DMABUF driver.

	  This driver works as abstraction layer that export and import
	  DMA_BUF from/to another virtual OS running on the same HW platform
	  powered by a hypervisor

config HYPER_DMABUF_SYSFS
	bool "Enable sysfs information about hyper DMA buffers"
	default y
	depends on HYPER_DMABUF
	help
	  Expose run-time information about currently imported and exported buffers
	  registered in EXPORT and IMPORT list in Hyper_DMABUF driver.

	  The location of sysfs is under "...."

config HYPER_DMABUF_EVENT_GEN
        bool "Enable event-generation and polling operation"
        default n
        depends on HYPER_DMABUF
        help
          With this config enabled, hyper_dmabuf driver on the importer side
          generates events and queue those up in the event list whenever a new
          shared DMA-BUF is available. Events in the list can be retrieved by
          read operation.

config HYPER_DMABUF_XEN
        bool "Configure hyper_dmabuf for XEN hypervisor"
        default y
        depends on HYPER_DMABUF && XEN && XENFS
        help
          Enabling Hyper_DMABUF Backend for XEN hypervisor

config HYPER_DMABUF_XEN_AUTO_RX_CH_ADD
        bool "Enable automatic rx-ch add with 10 secs interval"
        default y
        depends on HYPER_DMABUF && HYPER_DMABUF_XEN
        help
          If enabled, driver reads a node in xenstore every 10 seconds
          to check whether there is any tx comm ch configured by another
          domain then initialize matched rx comm ch automatically for any
          existing tx comm chs.

endmenu
```

## drivers/xen/hyper_dmabuf/Kconfig
```kconfig
menu "hyper_dmabuf options"

config HYPER_DMABUF
	tristate "Enables hyper dmabuf driver"
	default y

config HYPER_DMABUF_XEN
	bool "Configure hyper_dmabuf for XEN hypervisor"
	default y
	depends on HYPER_DMABUF
	help
	  Configuring hyper_dmabuf driver for XEN hypervisor

config HYPER_DMABUF_SYSFS
	bool "Enable sysfs information about hyper DMA buffers"
	default y
	depends on HYPER_DMABUF
	help
	  Expose information about imported and exported buffers using
	  hyper_dmabuf driver

endmenu
```
